## CMakeLists.txt
```
# Copyright (c) 2022-2023 Golioth, Inc.
# Copyright (c) 2025 Common Ground Electronics <https://cgnd.dev>
# SPDX-License-Identifier: Apache-2.0

cmake_minimum_required(VERSION 3.20.0)

find_package(Zephyr REQUIRED HINTS $ENV{ZEPHYR_BASE})

project(hackster_water_level_sensor)

target_sources(app PRIVATE src/main.c)
target_sources(app PRIVATE src/app_settings.c)
target_sources(app PRIVATE src/app_sensors.c)
target_sources(app PRIVATE src/app_battery.c)
```

## Kconfig
```
# Copyright (c) 2022-2023 Golioth, Inc.
# SPDX-License-Identifier: Apache-2.0

module = APP
module-str = APP

mainmenu "Hackster Water Level Sensor"

menu "App"

config APP_STREAM_DELAY_S
	int "Stream delay (in seconds)"
	default 900
	help
	  Delay between sending water level sensor readings to Golioth.

config APP_ACCEL_NUM_SAMPLES
	int "Number of accelerometer samples"
	default 100
	help
	  Total number of accelerometer samples used to calculate the float
	  angle.

config ACCEL_SAMPLE_DELAY_MS
	int "Accelerometer sample delay (in milliseconds)"
	default 100
	help
	  Delay between reading each accelerometer sample.

config APP_GOLIOTH_CONNECT_TIMEOUT_MS
	int "Golioth connect timeout (in milliseconds)"
	default 30000
	help
	  Timeout for connecting to Golioth.

config APP_GOLIOTH_STREAM_TIMEOUT_S
	int "Golioth stream timeout (in seconds)"
	default 30
	help
	  Timeout for sending stream requests to Golioth.

source "subsys/logging/Kconfig.template.log_config"

if DNS_RESOLVER

config DNS_SERVER_IP_ADDRESSES
	default y

config DNS_SERVER1
	default "1.1.1.1"

endif # DNS_RESOLVER

endmenu # App Options

menu "Zephyr Kernel"

source "Kconfig.zephyr"

endmenu # Zephyr Kernel
```

## sysbuild.conf
```
# Copyright (c) 2022-2023 Golioth, Inc.
#
# SPDX-License-Identifier: Apache-2.0

SB_CONFIG_BOOTLOADER_MCUBOOT=y
```

## west.yml
```
# Copyright (c) 2022-2023 Golioth, Inc.
# Copyright (c) 2025 Common Ground Electronics <https://cgnd.dev>
# SPDX-License-Identifier: Apache-2.0

manifest:
  version: 1.0

  group-filter:
    - +bsec

  projects:
    - name: golioth
      path: modules/lib/golioth-firmware-sdk
      revision: v0.19.1
      url: https://github.com/golioth/golioth-firmware-sdk.git
      west-commands: scripts/west-commands.yml
      submodules: true
      import:
        file: west-ncs.yml
        path-prefix: deps
        name-allowlist:
          - nrf
          - zephyr
          - bsec
          - cmsis
          - hal_nordic
          - mbedtls
          - mbedtls-nrf
          - mcuboot
          - net-tools
          - nrfxlib
          - oberon-psa-crypto
          - qcbor
          - segger
          - tfm-mcuboot
          - tinycrypt
          - trusted-firmware-m
          - zcbor

  self:
    path: app
```

## prj.conf
```kconfig
# Copyright (c) 2022-2023 Golioth, Inc.
# Copyright (c) 2025 Common Ground Electronics <https://cgnd.dev>
# SPDX-License-Identifier: Apache-2.0

# Configure the app name used in the boot banner
CONFIG_NCS_APPLICATION_BOOT_BANNER_STRING="Hackster Water Level Monitor App"

# Enable Golioth Firmware SDK
CONFIG_GOLIOTH_FIRMWARE_SDK=y

# Golioth services used in this app
CONFIG_GOLIOTH_FW_UPDATE=y
CONFIG_GOLIOTH_LIGHTDB_STATE=n
CONFIG_GOLIOTH_RPC=n
CONFIG_GOLIOTH_SETTINGS=y
CONFIG_GOLIOTH_STREAM=y

# Prevent the CoAP client from sending keepalive messages
# https://blog.golioth.io/nat-is-the-enemy-of-low-power-devices/
CONFIG_GOLIOTH_COAP_KEEPALIVE_INTERVAL_S=0
# CoAP client RX timeout set to 25hr (longer than the max stream delay of 24hr)
CONFIG_GOLIOTH_COAP_CLIENT_RX_TIMEOUT_SEC=90000
# Connection ID is not used because the connection to Golioth is explicitly
# started and stopped as needed.

# Configure Golioth SDK dependencies
CONFIG_ZVFS_EVENTFD_MAX=14
CONFIG_ZVFS_OPEN_MAX=23
CONFIG_MBEDTLS_ENABLE_HEAP=y
CONFIG_MBEDTLS_HEAP_SIZE=10240
CONFIG_NETWORKING=y
CONFIG_NET_IPV4=y
CONFIG_COAP_EXTENDED_OPTIONS_LEN=y
CONFIG_COAP_EXTENDED_OPTIONS_LEN_VALUE=39

# Enable LTE Power Saving Mode (PSM)
CONFIG_LTE_LC_PSM_MODULE=y
CONFIG_LTE_PSM_REQ=y
CONFIG_LTE_PROPRIETARY_PSM_REQ=y
CONFIG_LTE_PSM_REQ_FORMAT_SECONDS=y
# RPTAU set to 25hr (it should be longer than the max stream delay of 24hr)
CONFIG_LTE_PSM_REQ_RPTAU_SECONDS=90000
# No need for active paging after the RRC connection release
CONFIG_LTE_PSM_REQ_RAT_SECONDS=0

# Application
CONFIG_MAIN_STACK_SIZE=4096
CONFIG_FPU=y

# Flash memory (etc.) for firmware upgrade
CONFIG_FLASH=y
CONFIG_FLASH_MAP=y
CONFIG_NVS=y
CONFIG_STREAM_FLASH=y
CONFIG_IMG_MANAGER=y
CONFIG_IMG_ERASE_PROGRESSIVELY=y
CONFIG_REBOOT=y

# Device power management
CONFIG_PM_DEVICE=y

# Disable all serial input/output to save power
CONFIG_SERIAL=n
CONFIG_CONSOLE=n
CONFIG_UART_CONSOLE=n
CONFIG_SHELL=n
CONFIG_LOG=n

# Fuel Gauge
CONFIG_GPIO=y
CONFIG_REGULATOR=y
CONFIG_NRF_FUEL_GAUGE=y
CONFIG_NRF_FUEL_GAUGE_VARIANT_SECONDARY_CELL=y
```

## overlay-golioth-logging.conf
```kconfig
# Copyright (c) 2025 Common Ground Electronics <https://cgnd.dev>
# SPDX-License-Identifier: Apache-2.0

# NOTE: Enabling this debug configuration will reduce battery life!

# Enable logging
CONFIG_LOG=y

# Set the app log level to info by default
CONFIG_APP_LOG_LEVEL_INF=y

# Log the modem firmware version & UUID on boot
CONFIG_NRF_MODEM_LIB_LOG_FW_VERSION_UUID=y

# Forward log messages to Golioth cloud
CONFIG_LOG_BACKEND_GOLIOTH=y
CONFIG_LOG_PROCESS_THREAD_STACK_SIZE=1536
```

## overlay-golioth-runtime-psk.conf
```kconfig
# Copyright (c) 2025 Common Ground Electronics <https://cgnd.dev>
# SPDX-License-Identifier: Apache-2.0

# NOTE: This does not store the PSK securely, so it is only recommended for
# development and testing purposes.

# Enable settings subsystem with runtime storage backend
CONFIG_SETTINGS=y
CONFIG_SETTINGS_RUNTIME=y

# Ensure Golioth auth method is set to PSK (and not certificate)
CONFIG_GOLIOTH_AUTH_METHOD_CERT=n
CONFIG_GOLIOTH_AUTH_METHOD_PSK=y

# Enable golioth_sample_credentials_get() from the SDK examples common library
CONFIG_GOLIOTH_SAMPLE_COMMON=y

# Increase native TLS socket implementation, so that it is chosen instead of
# offloaded nRF91 sockets.
CONFIG_NET_SOCKETS_TLS_PRIORITY=35
```

## overlay-rtt-debug.conf
```kconfig
# Copyright (c) 2025 Common Ground Electronics <https://cgnd.dev>
# SPDX-License-Identifier: Apache-2.0

# NOTE: Enabling this debug configuration will reduce battery life!

# Configure the app name used in the boot banner
CONFIG_NCS_APPLICATION_BOOT_BANNER_STRING="[DEBUG] Hackster Water Level Monitor App"

# Enable Segger RTT
CONFIG_USE_SEGGER_RTT=y

# Enable the Zephyr console
CONFIG_CONSOLE=y

# Enable the Zephyr shell
CONFIG_SHELL=y

# Enable RTT backend for shell instead of serial
CONFIG_SHELL_BACKEND_SERIAL=n
CONFIG_SHELL_BACKEND_RTT=y

# Enable logging & logging shell commands
CONFIG_LOG=y
CONFIG_LOG_CMDS=y

# Enable sensor shell
CONFIG_SENSOR=y
CONFIG_SENSOR_INFO=y
CONFIG_SENSOR_SHELL=y

# Set the app log level to info by default
CONFIG_APP_LOG_LEVEL_INF=y

# Enable LTE modem sleep notifications
CONFIG_LTE_LC_MODEM_SLEEP_MODULE=y
CONFIG_LTE_LC_MODEM_SLEEP_NOTIFICATIONS=y

# Enable LTE Tracking Area Update pre-warning notifications
CONFIG_LTE_LC_TAU_PRE_WARNING_MODULE=y

# Log the modem firmware version & UUID on boot
CONFIG_NRF_MODEM_LIB_LOG_FW_VERSION_UUID=y
```

## overlay-serial-debug.conf
```kconfig
# Copyright (c) 2025 Common Ground Electronics <https://cgnd.dev>
# SPDX-License-Identifier: Apache-2.0

# NOTE: Enabling this debug configuration will reduce battery life!

# Configure the app name used in the boot banner
CONFIG_NCS_APPLICATION_BOOT_BANNER_STRING="[DEBUG] Hackster Water Level Monitor App"

# Enable the serial drivers for UART communication
CONFIG_SERIAL=y

# Enable the Zephyr console over UART
CONFIG_CONSOLE=y
CONFIG_UART_CONSOLE=y

# Enable the Zephyr shell
CONFIG_SHELL=y

# Enable logging & logging shell commands
CONFIG_LOG=y
CONFIG_LOG_CMDS=y

# Enable sensor shell
CONFIG_SENSOR=y
CONFIG_SENSOR_INFO=y
CONFIG_SENSOR_SHELL=y

# Set the app log level to info by default
CONFIG_APP_LOG_LEVEL_INF=y

# Enable LTE modem sleep notifications
CONFIG_LTE_LC_MODEM_SLEEP_MODULE=y
CONFIG_LTE_LC_MODEM_SLEEP_NOTIFICATIONS=y

# Enable LTE Tracking Area Update pre-warning notifications
CONFIG_LTE_LC_TAU_PRE_WARNING_MODULE=y

# Log the modem firmware version & UUID on boot
CONFIG_NRF_MODEM_LIB_LOG_FW_VERSION_UUID=y
```

## boards/thingy91x_nrf9151_ns.conf
```kconfig
# Copyright (c) 2024 Golioth, Inc.
# SPDX-License-Identifier: Apache-2.0

# Use a unique package name to use with Pacakges/Cohorts/Deployments
CONFIG_GOLIOTH_FW_UPDATE_PACKAGE_NAME="thingy91x"
```

## boards/thingy91x_nrf9151_ns.overlay
```dts
/*
 * Copyright (c) 2022-2023 Golioth, Inc.
 * Copyright (c) 2025 Common Ground Electronics <https://cgnd.dev>
 *
 * SPDX-License-Identifier: Apache-2.0
 */

&accel {
	status = "okay";
};
```

## src/main.c
```c
/*
 * Copyright (c) 2022-2023 Golioth, Inc.
 * Copyright (c) 2025 Common Ground Electronics <https://cgnd.dev>
 *
 * SPDX-License-Identifier: Apache-2.0
 */

#include <app_version.h>
#include <golioth/client.h>
#include <golioth/fw_update.h>
#include <golioth/stream.h>
#include <modem/lte_lc.h>
#include <zephyr/logging/log.h>
#include <zephyr/kernel.h>
#include <zephyr/pm/device.h>

#include "app_battery.h"
#include "app_sensors.h"
#include "app_settings.h"

LOG_MODULE_REGISTER(main, CONFIG_APP_LOG_LEVEL);

/* TODO: Is there a better way to determine if we are using runtime PSK auth? */
#define RUNTIME_PSK_AUTH (CONFIG_NET_SOCKETS_TLS_PRIORITY < CONFIG_NET_SOCKETS_OFFLOAD_PRIORITY)

#if RUNTIME_PSK_AUTH
#include <samples/common/sample_credentials.h>
#endif

/* Current firmware version; update in VERSION */
static const char *s_current_version =
	STRINGIFY(APP_VERSION_MAJOR) "." STRINGIFY(APP_VERSION_MINOR) "." STRINGIFY(APP_PATCHLEVEL);
static struct golioth_client *s_client;
static k_tid_t s_system_thread;
#if defined(CONFIG_PM_DEVICE)
static const struct device *const s_flash_ext_dev = DEVICE_DT_GET(DT_ALIAS(spi_flash0));
#endif

K_SEM_DEFINE(lte_connected_sem, 0, 1);
K_SEM_DEFINE(golioth_ota_sem, 0, 1);

void wake_system_thread(void)
{
	k_wakeup(s_system_thread);
}

#if defined(CONFIG_PM_DEVICE)
static void spi_flash_suspend(void)
{
	if (device_is_ready(s_flash_ext_dev)) {
		/* Suspend external flash */
		pm_device_action_run(s_flash_ext_dev, PM_DEVICE_ACTION_SUSPEND);
	}
}

static void spi_flash_resume(void)
{
	if (device_is_ready(s_flash_ext_dev)) {
		/* Resume external flash */
		pm_device_action_run(s_flash_ext_dev, PM_DEVICE_ACTION_RESUME);
	}
}
#endif

static void on_client_event(struct golioth_client *client, enum golioth_client_event event,
			    void *arg)
{
	switch (event) {
	case GOLIOTH_CLIENT_EVENT_CONNECTED:
		LOG_INF("Golioth client connected");
		break;
	case GOLIOTH_CLIENT_EVENT_DISCONNECTED:
		LOG_INF("Golioth client disconnected");
		app_settings_invalidate();
		break;
	default:
		break;
	}
}

static void on_fw_update_state_change(enum golioth_ota_state state, enum golioth_ota_reason reason,
				      void *user_arg)
{
	switch (state) {
	case GOLIOTH_OTA_STATE_IDLE:
		k_sem_reset(&golioth_ota_sem);
		break;
	case GOLIOTH_OTA_STATE_DOWNLOADING:
		__fallthrough;
	case GOLIOTH_OTA_STATE_DOWNLOADED:
		__fallthrough;
	case GOLIOTH_OTA_STATE_UPDATING:
		k_sem_give(&golioth_ota_sem);
		break;
	default:
		break;
	}
}

static void golioth_client_init(void)
{
#if RUNTIME_PSK_AUTH
	/* Get the client configuration from auto-loaded settings */
	const struct golioth_client_config *client_config = golioth_sample_credentials_get();

	LOG_INF("Loaded Golioth credentials from settings subsystem");
#else
	/* Get the client configuration from the nRF9151 modem */
	const struct golioth_client_config gclient_config = {
		.credentials =
			{
				.auth_type = GOLIOTH_TLS_AUTH_TYPE_TAG,
				.tag = CONFIG_GOLIOTH_COAP_CLIENT_CREDENTIALS_TAG,
			},
	};

	const struct golioth_client_config *client_config = &gclient_config;

	LOG_INF("Loaded Golioth credentials from modem credential storage");
#endif
	/* Create and start a Golioth Client */
	s_client = golioth_client_create(client_config);

	/* Register Golioth on_connect callback */
	golioth_client_register_event_callback(s_client, on_client_event, NULL);

	/* Initialize DFU components */
	golioth_fw_update_init(s_client, s_current_version);
	golioth_fw_update_register_state_change_callback(on_fw_update_state_change, NULL);

	/* Initialize app settings module */
	app_settings_init(s_client);

	/* Initialize app sensors module */
	app_sensors_init(s_client);
}

static void lte_handler(const struct lte_lc_evt *const evt)
{
	switch (evt->type) {
	case LTE_LC_EVT_NW_REG_STATUS:
		if ((evt->nw_reg_status == LTE_LC_NW_REG_REGISTERED_HOME) ||
		    (evt->nw_reg_status == LTE_LC_NW_REG_REGISTERED_ROAMING)) {
			LOG_INF("LTE network registration status: %s",
				evt->nw_reg_status == LTE_LC_NW_REG_REGISTERED_HOME
					? "Registered, home network"
					: "Registered, roaming");
			k_sem_give(&lte_connected_sem);
		}
		break;
	case LTE_LC_EVT_LTE_MODE_UPDATE:
		LOG_INF("LTE mode: %s",
			(evt->lte_mode == LTE_LC_LTE_MODE_LTEM) ? "LTE-M" : "NB-IoT");
		break;
	case LTE_LC_EVT_RRC_UPDATE:
		LOG_INF("LTE RRC connection state: %s",
			(evt->rrc_mode == LTE_LC_RRC_MODE_CONNECTED) ? "Connected" : "Idle");
		break;
#if defined(CONFIG_LTE_LC_PSM_MODULE)
	case LTE_LC_EVT_PSM_UPDATE:
		LOG_INF("LTE PSM parameter update: TAU: %d s, Active time: %d s", evt->psm_cfg.tau,
			evt->psm_cfg.active_time);
		break;
#endif
#if defined(CONFIG_LTE_LC_TAU_PRE_WARNING_MODULE)
	case LTE_LC_EVT_TAU_PRE_WARNING:
		LOG_INF("LTE modem will perform a Tracking Area Update in %lld ms", evt->time);
		break;
#endif
#if defined(CONFIG_LTE_LC_MODEM_SLEEP_NOTIFICATIONS)
	case LTE_LC_EVT_MODEM_SLEEP_EXIT_PRE_WARNING:
		LOG_INF("LTE modem will exit sleep in %lld ms", evt->modem_sleep.time);
		break;
	case LTE_LC_EVT_MODEM_SLEEP_EXIT:
		LOG_INF("LTE modem exited sleep after %lld ms", evt->modem_sleep.time);
		break;
	case LTE_LC_EVT_MODEM_SLEEP_ENTER:
		// lte_modem_enter_sleep(&evt->modem_sleep);
		switch (evt->modem_sleep.type) {
		case LTE_LC_MODEM_SLEEP_PSM:
		case LTE_LC_MODEM_SLEEP_PROPRIETARY_PSM:
			LOG_INF("LTE modem entered PSM sleep for %lld ms", evt->modem_sleep.time);
			break;
		case LTE_LC_MODEM_SLEEP_RF_INACTIVITY:
			LOG_INF("LTE modem entered eDRX sleep, time %lld", evt->modem_sleep.time);
			break;
		case LTE_LC_MODEM_SLEEP_LIMITED_SERVICE:
			LOG_INF("LTE modem entered limited service sleep, time %lld",
				evt->modem_sleep.time);
			break;
		case LTE_LC_MODEM_SLEEP_FLIGHT_MODE:
			LOG_INF("LTE modem entered flight mode sleep, time %lld",
				evt->modem_sleep.time);
			break;
		default:
			break;
		}
		break;
#endif
	default:
		break;
	}
}

int main(void)
{
	/* Get system thread id so measurement interval changes can wake main */
	s_system_thread = k_current_get();

	/* Initialize battery monitoring */
	app_battery_init();

	/* Wait for LTE connection */
	LOG_INF("Connecting to LTE, this may take some time...");
	lte_lc_connect_async(lte_handler);
	k_sem_take(&lte_connected_sem, K_FOREVER);

	/* Create and start a Golioth Client */
	golioth_client_init();

	while (true) {
#if defined(CONFIG_PM_DEVICE)
		/* Turn on external SPI flash so it can be used for OTA */
		spi_flash_resume();
#endif

		/*
		 * The connection to Golioth will be dropped when the LTE link
		 * goes down for long periods of time (e.g. when PSM is
		 * entered). While the device is sleeping, any services that
		 * have active CoAP observations will not receive notifications.
		 * To ensure that the observations are received eventually, the
		 * client is started and stopped each time the system wakes up,
		 * which re-registers the observations and gets the latest
		 * values from the server. This is not ideal for power
		 * consumption because it requires a full DTLS handshake each
		 * time, but it avoids the need for a frequent keepalive to
		 * ensure observations for settings and OTA are not missed.
		 */
		if (!golioth_client_is_running(s_client)) {
			golioth_client_start(s_client);
		}

		LOG_INF("Waiting for connection to Golioth...");
		golioth_client_wait_for_connect(s_client, CONFIG_APP_GOLIOTH_CONNECT_TIMEOUT_S);

		/* Only stream sensor data if settings have been received */
		if (app_settings_wait_for_updates()) {
			app_sensors_read_and_stream();
		}

		if (k_sem_count_get(&golioth_ota_sem) == 0) {
			/* Only stop the client when OTA is in the idle state */
			golioth_client_stop(s_client);

#if defined(CONFIG_PM_DEVICE)
			/* Suspend external flash to save power */
			spi_flash_suspend();
#endif
		}

		k_sleep(K_SECONDS(get_stream_delay_s()));
	}
}
```

## src/app_battery.c
```c
/*
 * Copyright (c) 2025 Common Ground Electronics <https://cgnd.dev>
 * Copyright (c) 2023 Nordic Semiconductor ASA
 * SPDX-License-Identifier: LicenseRef-Nordic-5-Clause
 */

#include "app_battery.h"

#include <stdlib.h>

#include <nrf_fuel_gauge.h>
#include <zephyr/kernel.h>
#include <zephyr/device.h>
#include <zephyr/drivers/gpio.h>
#include <zephyr/drivers/mfd/npm1300.h>
#include <zephyr/drivers/sensor.h>
#include <zephyr/drivers/sensor/npm1300_charger.h>
#include <zephyr/logging/log.h>

#include "lp803448_model.h"

LOG_MODULE_REGISTER(app_battery, CONFIG_APP_LOG_LEVEL);

/* nPM1300 CHARGER.BCHGCHARGESTATUS register bitmasks */
#define NPM1300_CHG_STATUS_COMPLETE_MASK BIT(1)
#define NPM1300_CHG_STATUS_TRICKLE_MASK	 BIT(2)
#define NPM1300_CHG_STATUS_CC_MASK	 BIT(3)
#define NPM1300_CHG_STATUS_CV_MASK	 BIT(4)

static const struct device *pmic = DEVICE_DT_GET(DT_NODELABEL(pmic_main));
static const struct device *charger = DEVICE_DT_GET(DT_NODELABEL(npm1300_charger));
static volatile bool vbus_connected;
static int64_t ref_time;

static int charger_read_sensors(float *voltage, float *current, float *temp, int32_t *chg_status)
{
	struct sensor_value value;
	int err;

	err = sensor_sample_fetch(charger);
	if (err < 0) {
		LOG_ERR("Could not fetch sensor data from charger");
		return err;
	}

	sensor_channel_get(charger, SENSOR_CHAN_GAUGE_VOLTAGE, &value);
	*voltage = sensor_value_to_float(&value);

	sensor_channel_get(charger, SENSOR_CHAN_GAUGE_TEMP, &value);
	*temp = sensor_value_to_float(&value);

	sensor_channel_get(charger, SENSOR_CHAN_GAUGE_AVG_CURRENT, &value);
	*current = sensor_value_to_float(&value);

	sensor_channel_get(charger, SENSOR_CHAN_NPM1300_CHARGER_STATUS, &value);
	*chg_status = value.val1;

	return 0;
}

static int charge_status_update(int32_t chg_status)
{
	union nrf_fuel_gauge_ext_state_info_data state_info;

	if (chg_status & NPM1300_CHG_STATUS_COMPLETE_MASK) {
		LOG_DBG("Charge complete");
		state_info.charge_state = NRF_FUEL_GAUGE_CHARGE_STATE_COMPLETE;
	} else if (chg_status & NPM1300_CHG_STATUS_TRICKLE_MASK) {
		LOG_DBG("Trickle charging");
		state_info.charge_state = NRF_FUEL_GAUGE_CHARGE_STATE_TRICKLE;
	} else if (chg_status & NPM1300_CHG_STATUS_CC_MASK) {
		LOG_DBG("Constant current charging");
		state_info.charge_state = NRF_FUEL_GAUGE_CHARGE_STATE_CC;
	} else if (chg_status & NPM1300_CHG_STATUS_CV_MASK) {
		LOG_DBG("Constant voltage charging");
		state_info.charge_state = NRF_FUEL_GAUGE_CHARGE_STATE_CV;
	} else {
		LOG_DBG("Charger idle");
		state_info.charge_state = NRF_FUEL_GAUGE_CHARGE_STATE_IDLE;
	}

	return nrf_fuel_gauge_ext_state_update(NRF_FUEL_GAUGE_EXT_STATE_INFO_CHARGE_STATE_CHANGE,
					       &state_info);
}

static int fuel_gauge_init(void)
{
	struct sensor_value value;
	struct nrf_fuel_gauge_init_parameters parameters = {
		.model = &battery_model,
		.opt_params = NULL,
		.state = NULL,
	};
	float max_charge_current;
	float term_charge_current;
	int32_t chg_status;
	int err;

	LOG_INF("nRF Fuel Gauge version: %s", nrf_fuel_gauge_version);

	/* Read initial values from the charger used to initialize the fuel gauge */
	err = charger_read_sensors(&parameters.v0, &parameters.i0, &parameters.t0, &chg_status);
	if (err < 0) {
		LOG_ERR("Could not read sensors from charger device");
		return err;
	}

	/* Store charge nominal and termination current, needed for ttf calculation */
	sensor_channel_get(charger, SENSOR_CHAN_GAUGE_DESIRED_CHARGING_CURRENT, &value);
	max_charge_current = sensor_value_to_float(&value);
	term_charge_current = max_charge_current / 10.f;

	err = nrf_fuel_gauge_init(&parameters, NULL);
	if (err < 0) {
		LOG_ERR("Could not initialize fuel gauge");
		return err;
	}

	ref_time = k_uptime_get();

	err = nrf_fuel_gauge_ext_state_update(NRF_FUEL_GAUGE_EXT_STATE_INFO_CHARGE_CURRENT_LIMIT,
					      &(union nrf_fuel_gauge_ext_state_info_data){
						      .charge_current_limit = max_charge_current});
	if (err < 0) {
		LOG_ERR("Error: Could not update fuel gauge charge current limit");
		return err;
	}

	err = nrf_fuel_gauge_ext_state_update(NRF_FUEL_GAUGE_EXT_STATE_INFO_TERM_CURRENT,
					      &(union nrf_fuel_gauge_ext_state_info_data){
						      .charge_term_current = term_charge_current});
	if (err < 0) {
		LOG_ERR("Error: Could not update fuel gauge termination current");
		return err;
	}

	err = charge_status_update(chg_status);
	if (err < 0) {
		LOG_ERR("Could not update fuel gauge charging state");
		return err;
	}

	return 0;
}

int fuel_gauge_sample(struct battery_status *status)
{
	static int32_t chg_status_prev;

	float voltage;
	float current;
	float temp;
	float soc;
	float tte;
	float ttf;
	float delta;
	int32_t chg_status;
	int err;

	err = charger_read_sensors(&voltage, &current, &temp, &chg_status);
	if (err < 0) {
		LOG_ERR("Could not read from charger device");
		return err;
	}

	err = nrf_fuel_gauge_ext_state_update(
		vbus_connected ? NRF_FUEL_GAUGE_EXT_STATE_INFO_VBUS_CONNECTED
			       : NRF_FUEL_GAUGE_EXT_STATE_INFO_VBUS_DISCONNECTED,
		NULL);
	if (err < 0) {
		LOG_ERR("Could not update Vbus connected state");
		return err;
	}

	if (chg_status != chg_status_prev) {
		chg_status_prev = chg_status;

		err = charge_status_update(chg_status);
		if (err < 0) {
			LOG_ERR("Could not update fuel gauge charging state");
			return err;
		}
	}

	delta = (float)k_uptime_delta(&ref_time) / 1000.f;

	soc = nrf_fuel_gauge_process(voltage, current, temp, delta, NULL);
	tte = nrf_fuel_gauge_tte_get();
	ttf = nrf_fuel_gauge_ttf_get();

	LOG_INF("V: %.3f V, I: %.3f A, T: %.2f °C, SoC: %.2f%%, TTE: %.0f s, TTF: %.0f s",
		(double)voltage, (double)current, (double)temp, (double)soc, (double)tte,
		(double)ttf);

	status->voltage_v = voltage;
	status->current_a = current;
	status->temp_c = temp;
	status->soc_pct = soc;
	status->tte_s = tte;
	status->ttf_s = ttf;

	return 0;
}

static void npm1300_event_callback(const struct device *dev, struct gpio_callback *cb,
				   uint32_t pins)
{
	if (pins & BIT(NPM1300_EVENT_VBUS_DETECTED)) {
		LOG_DBG("Vbus connected");
		vbus_connected = true;
	}

	if (pins & BIT(NPM1300_EVENT_VBUS_REMOVED)) {
		LOG_DBG("Vbus removed");
		vbus_connected = false;
	}
}

int app_battery_init(void)
{
	int err;
	static struct gpio_callback event_cb;
	struct sensor_value val;

	if (!device_is_ready(pmic)) {
		LOG_ERR("PMIC device not ready");
		return -ENODEV;
	}

	if (!device_is_ready(charger)) {
		LOG_ERR("Charger device not ready");
		return -ENODEV;
	}

	if (fuel_gauge_init() < 0) {
		LOG_ERR("Could not initialize fuel gauge");
		return -ENODEV;
	}

	gpio_init_callback(&event_cb, npm1300_event_callback,
			   BIT(NPM1300_EVENT_VBUS_DETECTED) | BIT(NPM1300_EVENT_VBUS_REMOVED));

	err = mfd_npm1300_add_callback(pmic, &event_cb);
	if (err) {
		LOG_ERR("Failed to add PMIC callback");
		return err;
	}

	/* Initialise vbus detection status. */
	err = sensor_attr_get(charger, SENSOR_CHAN_CURRENT, SENSOR_ATTR_UPPER_THRESH, &val);
	if (err) {
		return err;
	}

	vbus_connected = (val.val1 != 0) || (val.val2 != 0);

	LOG_DBG("PMIC initialized");

	return 0;
}
```

## src/app_battery.h
```c
/*
 * Copyright (c) 2025 Common Ground Electronics <https://cgnd.dev>
 * Copyright (c) 2023 Nordic Semiconductor ASA
 * SPDX-License-Identifier: LicenseRef-Nordic-5-Clause
 */

#ifndef __APP_BATTERY_H__
#define __APP_BATTERY_H__

struct battery_status {
	double voltage_v;
	double current_a;
	double temp_c;
	double soc_pct;
	double tte_s;
	double ttf_s;
};

int app_battery_init(void);
int fuel_gauge_sample(struct battery_status *status);

#endif /* __APP_BATTERY_H__ */
```

## src/app_sensors.c
```c
/*
 * Copyright (c) 2022-2023 Golioth, Inc.
 * Copyright (c) 2025 Common Ground Electronics <https://cgnd.dev>
 *
 * SPDX-License-Identifier: Apache-2.0
 */

#include "app_sensors.h"

#include <stdlib.h>
#include <math.h>

#include <golioth/client.h>
#include <golioth/stream.h>
#include <zcbor_encode.h>
#include <zephyr/device.h>
#include <zephyr/drivers/gpio.h>
#include <zephyr/drivers/sensor.h>
#include <zephyr/logging/log.h>

#include "app_battery.h"
#include "app_settings.h"

LOG_MODULE_REGISTER(app_sensors, CONFIG_APP_LOG_LEVEL);

/*
 * By default, picolibc is built for Zephyr with the _ZEPHYR_SOURCE feature test
 * macro unless some other API indicator (like _XOPEN_SOURCE) is set. As a
 * result, this does not include some useful math constants like M_PI.
 *
 * See picolibc/newlib/libc/include/sys/features.h and
 * https://github.com/zephyrproject-rtos/zephyr/issues/66909 for more details.
 */
#ifndef M_PI
#define M_PI 3.14159265358979323846
#endif

static struct golioth_client *s_client;

/* Sensor device structs */
static const struct device *const s_accel = DEVICE_DT_GET_ONE(adi_adxl367);

void app_sensors_init(struct golioth_client *client)
{
	s_client = client;
}

static inline double rad_to_deg(double rad)
{
	return rad * (180.0 / M_PI);
}

static int read_accel_sensor(struct accel_xyz *accel_data)
{
	struct sensor_value accel_x;
	struct sensor_value accel_y;
	struct sensor_value accel_z;

	if (!device_is_ready(s_accel)) {
		LOG_ERR("%s is not ready", s_accel->name);
		return -ENODEV;
	}

	int err = sensor_sample_fetch(s_accel);
	if (err) {
		LOG_ERR("Error fetching low-power accelerometer sensor sample: %d", err);
		return err;
	}

	sensor_channel_get(s_accel, SENSOR_CHAN_ACCEL_X, &accel_x);
	sensor_channel_get(s_accel, SENSOR_CHAN_ACCEL_Y, &accel_y);
	sensor_channel_get(s_accel, SENSOR_CHAN_ACCEL_Z, &accel_z);

	/* Raw accelerometer output values in m/s² */
	double x = sensor_value_to_double(&accel_x);
	double y = sensor_value_to_double(&accel_y);
	double z = sensor_value_to_double(&accel_z);

	accel_data->x = x;
	accel_data->y = y;
	accel_data->z = z;

	return 0;
}

static void calculate_tilt(struct accel_xyz *accel_data, struct tilt_sensor *tilt_data)
{
	double x = accel_data->x;
	double y = accel_data->y;
	double z = accel_data->z;

	/* A positive tilt angle means that the corresponding positive axis of
	 * the accelerometer is pointed above the horizon, whereas a negative
	 * angle means that the axis is pointed below the horizon. However, the
	 * low-power accelerometer (ADXL367) on the Thingy:91 X is located on
	 * the bottom side of the board, so the axis are reversed relative to
	 * the horizon and the acceleration due to gravity is measured as a
	 * negative value. As a result, the sign of the tilt angles needs to be
	 * reversed.
	 *
	 * The accelerometer positive X-axis points in the direction from the
	 * USB port towards the power switch. The accelerometer positive Y-axis
	 * points in the direction looking into the USB port.
	 *
	 * Assumptions:
	 * 1. The Thingy:91 X is installed right-side up, i.e. the yellow half
	 *    of the enclosure is on the bottom facing the earth and the orange
	 *    half of the enclosure is on the top facing the sky.
	 * 2. The Thingy:91 X is installed with the USB connector pointing down
	 *    the pivot arm in the direction of the float.
	 */
	tilt_data->roll_rad = -atan2(x, sqrt(y * y + z * z));
	tilt_data->pitch_rad = -atan2(y, sqrt(x * x + z * z));
}

static void calculate_water_level(struct tilt_sensor *tilt_data,
				  struct water_level_sensor *water_level_data)
{
	double float_length_in = (double)get_float_length_in();
	double float_offset_in = (double)get_float_offset_in();
	double pitch_rad = tilt_data->pitch_rad;

	/* Calculate the height of the float relative to the hinge */
	water_level_data->float_length_in = float_length_in;
	water_level_data->float_offset_in = float_offset_in;
	water_level_data->float_height_in = float_length_in * sin(pitch_rad) + float_offset_in;
}

static int encode_accel_data(zcbor_state_t *zse, struct accel_xyz *accel_data)
{
	bool ok;

	ok = zcbor_tstr_put_lit(zse, "accel") && zcbor_map_start_encode(zse, 3);
	if (!ok) {
		LOG_ERR("ZCBOR unable to open accel map");
		return -1;
	}

	ok = zcbor_tstr_put_lit(zse, "x") && zcbor_float64_put(zse, accel_data->x) &&
	     zcbor_tstr_put_lit(zse, "y") && zcbor_float64_put(zse, accel_data->y) &&
	     zcbor_tstr_put_lit(zse, "z") && zcbor_float64_put(zse, accel_data->z);
	if (!ok) {
		LOG_ERR("ZCBOR failed to encode accel data");
		return -1;
	}

	ok = zcbor_map_end_encode(zse, 3);
	if (!ok) {
		LOG_ERR("ZCBOR failed to close accel map");
		return -1;
	}

	return 0;
}

static int encode_tilt_sensor_data(zcbor_state_t *zse, struct tilt_sensor *tilt_data)
{
	bool ok;

	ok = zcbor_tstr_put_lit(zse, "tilt") && zcbor_map_start_encode(zse, 2);
	if (!ok) {
		LOG_ERR("ZCBOR unable to open tilt map");
		return -1;
	}

	ok = zcbor_tstr_put_lit(zse, "pitch") &&
	     zcbor_float64_put(zse, rad_to_deg(tilt_data->pitch_rad)) &&
	     zcbor_tstr_put_lit(zse, "roll") &&
	     zcbor_float64_put(zse, rad_to_deg(tilt_data->roll_rad));
	if (!ok) {
		LOG_ERR("ZCBOR failed to encode tilt data");
		return -1;
	}

	ok = zcbor_map_end_encode(zse, 2);
	if (!ok) {
		LOG_ERR("ZCBOR failed to close tilt map");
		return -1;
	}

	return 0;
}

static int encode_water_level_sensor_data(zcbor_state_t *zse,
					  struct water_level_sensor *water_level_data)
{
	bool ok;

	ok = zcbor_tstr_put_lit(zse, "water_level") && zcbor_map_start_encode(zse, 3);
	if (!ok) {
		LOG_ERR("ZCBOR unable to open water_level map");
		return -1;
	}

	ok = zcbor_tstr_put_lit(zse, "float_length") &&
	     zcbor_float64_put(zse, water_level_data->float_length_in) &&
	     zcbor_tstr_put_lit(zse, "float_offset") &&
	     zcbor_float64_put(zse, water_level_data->float_offset_in) &&
	     zcbor_tstr_put_lit(zse, "float_height") &&
	     zcbor_float64_put(zse, water_level_data->float_height_in);
	if (!ok) {
		LOG_ERR("ZCBOR failed to encode water_level data");
		return -1;
	}

	ok = zcbor_map_end_encode(zse, 3);
	if (!ok) {
		LOG_ERR("ZCBOR failed to close water_level map");
		return -1;
	}

	return 0;
}

static double json_safe_time(double value)
{
	if (isnan(value) || isinf(value)) {
		return -1;
	}
	return value;
}

static int encode_battery_status_data(zcbor_state_t *zse, struct battery_status *battery_data)
{
	bool ok;

	ok = zcbor_tstr_put_lit(zse, "battery") && zcbor_map_start_encode(zse, 6);
	if (!ok) {
		LOG_ERR("ZCBOR unable to open battery map");
		return -1;
	}

	ok = zcbor_tstr_put_lit(zse, "voltage") &&
	     zcbor_float64_put(zse, battery_data->voltage_v) &&
	     zcbor_tstr_put_lit(zse, "current") &&
	     zcbor_float64_put(zse, battery_data->current_a) && zcbor_tstr_put_lit(zse, "temp") &&
	     zcbor_float64_put(zse, battery_data->temp_c) && zcbor_tstr_put_lit(zse, "soc") &&
	     zcbor_float64_put(zse, battery_data->soc_pct) && zcbor_tstr_put_lit(zse, "tte") &&
	     zcbor_float64_put(zse, json_safe_time(battery_data->tte_s)) &&
	     zcbor_tstr_put_lit(zse, "ttf") &&
	     zcbor_float64_put(zse, json_safe_time(battery_data->ttf_s));
	if (!ok) {
		LOG_ERR("ZCBOR failed to encode battery data");
		return -1;
	}

	ok = zcbor_map_end_encode(zse, 6);
	if (!ok) {
		LOG_ERR("ZCBOR failed to close battery map");
		return -1;
	}

	return 0;
}

static int encode_sensor_data(zcbor_state_t *zse, struct accel_xyz *accel_data,
			      struct tilt_sensor *tilt_data,
			      struct water_level_sensor *water_level_data,
			      struct battery_status *battery_data)
{
	int err;
	bool ok;

	ok = zcbor_map_start_encode(zse, 4);
	if (!ok) {
		LOG_ERR("ZCBOR failed to open map");
		return -1;
	}

	err = encode_accel_data(zse, accel_data);
	if (err) {
		return -1;
	}

	err = encode_tilt_sensor_data(zse, tilt_data);
	if (err) {
		return -1;
	}

	err = encode_water_level_sensor_data(zse, water_level_data);
	if (err) {
		return -1;
	}

	err = encode_battery_status_data(zse, battery_data);
	if (err) {
		return -1;
	}

	ok = zcbor_map_end_encode(zse, 4);
	if (!ok) {
		LOG_ERR("ZCBOR failed to close map");
		return -1;
	}

	return 0;
}

/* This will be called by the main() loop after delays or on button presses */
/* Do all of your work here! */
void app_sensors_read_and_stream(void)
{
	int err;
	int accel_num_samples = get_accel_num_samples();
	int accel_sample_delay_ms = get_accel_sample_delay_ms();
	char cbor_buf[512];
	struct accel_xyz accel_sample, accel_data;
	struct tilt_sensor tilt_data;
	struct water_level_sensor water_level_data;
	struct battery_status battery_data;

	/* Average accelerometer samples */
	accel_data.x = 0;
	accel_data.y = 0;
	accel_data.z = 0;

	for (int i = 0; i < accel_num_samples; i++) {
		err = read_accel_sensor(&accel_sample);
		if (err) {
			return;
		}

		if (i == 0) {
			accel_data.x = accel_sample.x;
			accel_data.y = accel_sample.y;
			accel_data.z = accel_sample.z;
		} else {
			accel_data.x += accel_sample.x;
			accel_data.y += accel_sample.y;
			accel_data.z += accel_sample.z;
		}

		LOG_DBG("Sample %d: X: %.6f, Y: %.6f, Z: %.6f", i, accel_sample.x, accel_sample.y,
			accel_sample.z);

		k_sleep(K_MSEC(accel_sample_delay_ms));
	}

	accel_data.x /= accel_num_samples;
	accel_data.y /= accel_num_samples;
	accel_data.z /= accel_num_samples;

	/* Calculate tilt and water level from accelerometer data */
	calculate_tilt(&accel_data, &tilt_data);
	calculate_water_level(&tilt_data, &water_level_data);

	/* Read battery status */
	fuel_gauge_sample(&battery_data);

	LOG_INF("X: %.6f; Y: %.6f; Z: %.6f", accel_data.x, accel_data.y, accel_data.z);
	LOG_INF("roll: %.2f°, pitch: %.2f°", rad_to_deg(tilt_data.roll_rad),
		rad_to_deg(tilt_data.pitch_rad));
	LOG_INF("float length: %.2f in, float offset: %.2f in, float height: %.2f in",
		water_level_data.float_length_in, water_level_data.float_offset_in,
		water_level_data.float_height_in);

	/* Only stream sensor data if connected */
	if (golioth_client_is_connected(s_client)) {
		/* Encode data as CBOR */
		ZCBOR_STATE_E(zse, 3, cbor_buf, sizeof(cbor_buf), 1);
		err = encode_sensor_data(zse, &accel_data, &tilt_data, &water_level_data,
					 &battery_data);
		if (err) {
			return;
		}
		size_t cbor_size = zse->payload - (const uint8_t *)cbor_buf;

		/*
		 * Send to LightDB Stream on the "sensor" endpoint.
		 * Since the client is stopped manually right after sending,
		 * it's simplest to just use the sync stream variant to block
		 * until a response is received or a timeout occurs (if async is
		 * used, the client needs to be kept running until a response is
		 * received).
		 */
		err = golioth_stream_set_sync(s_client, "sensor", GOLIOTH_CONTENT_TYPE_CBOR,
					      cbor_buf, cbor_size,
					      CONFIG_APP_GOLIOTH_STREAM_TIMEOUT_S);
		if (err != GOLIOTH_OK) {
			LOG_ERR("Failed to send sensor data to Golioth: %d", err);
		} else {
			LOG_INF("Sent sensor data to Golioth");
		}
	} else {
		LOG_WRN("No connection available, skipping sending sensor data to Golioth");
	}
}
```

## src/app_sensors.h
```c
/*
 * Copyright (c) 2022-2023 Golioth, Inc.
 * Copyright (c) 2025 Common Ground Electronics <https://cgnd.dev>
 *
 * SPDX-License-Identifier: Apache-2.0
 */

#ifndef __APP_SENSORS_H__
#define __APP_SENSORS_H__

#include <golioth/client.h>

struct accel_xyz {
	double x;
	double y;
	double z;
};

struct tilt_sensor {
	double pitch_rad;
	double roll_rad;
};

struct water_level_sensor {
	double float_length_in;
	double float_offset_in;
	double float_height_in;
};

void app_sensors_init(struct golioth_client *client);
void app_sensors_read_and_stream(void);

#endif /* __APP_SENSORS_H__ */
```

## src/app_settings.c
```c
/*
 * Copyright (c) 2022-2023 Golioth, Inc.
 * Copyright (c) 2025 Common Ground Electronics <https://cgnd.dev>
 *
 * SPDX-License-Identifier: Apache-2.0
 */

#include "app_settings.h"

#include <golioth/client.h>
#include <golioth/settings.h>
#include <zephyr/kernel.h>
#include <zephyr/logging/log.h>

#include "main.h"

LOG_MODULE_REGISTER(app_settings, CONFIG_APP_LOG_LEVEL);

#define STREAM_DELAY_S_MIN	  1
#define STREAM_DELAY_S_MAX	  86400 /* 24 hours */
#define ACCEL_NUM_SAMPLES_MIN	  1
#define ACCEL_NUM_SAMPLES_MAX	  INT32_MAX
#define ACCEL_SAMPLE_DELAY_MS_MIN 0
#define ACCEL_SAMPLE_DELAY_MS_MAX INT32_MAX

static struct golioth_settings *s_settings;
static int32_t s_stream_delay_s = CONFIG_APP_STREAM_DELAY_S;
static float s_float_length_in = 0.0;
static float s_float_offset_in = 0.0;
static int32_t s_accel_num_samples = CONFIG_APP_ACCEL_NUM_SAMPLES;
static int32_t s_accel_sample_delay_ms = CONFIG_ACCEL_SAMPLE_DELAY_MS;
static bool s_stream_delay_s_valid = false;
static bool s_float_length_valid = false;
static bool s_float_offset_valid = false;
static bool s_accel_num_samples_valid = false;
static bool s_accel_sample_delay_ms_valid = false;

K_SEM_DEFINE(settings_valid_sem, 0, 1);

bool app_settings_are_valid(void)
{
	return s_stream_delay_s_valid && s_float_length_valid && s_float_offset_valid &&
	       s_accel_num_samples_valid && s_accel_sample_delay_ms_valid;
}

void app_settings_invalidate(void)
{
	s_stream_delay_s_valid = false;
	s_float_length_valid = false;
	s_float_offset_valid = false;
	s_accel_num_samples_valid = false;
	s_accel_sample_delay_ms_valid = false;
	k_sem_reset(&settings_valid_sem);
}

bool app_settings_wait_for_updates(void)
{
	int err;

	if (app_settings_are_valid()) {
		LOG_INF("Settings are up to date");
		return true;
	}

	LOG_INF("Waiting for updated settings...");
	err = k_sem_take(&settings_valid_sem, K_MSEC(CONFIG_APP_GOLIOTH_SETTINGS_TIMEOUT_MS));
	if (err == -EAGAIN) {
		LOG_ERR("Timeout (or semaphore reset) while waiting for updated settings");
		return false;
	} else if (err == -EBUSY) {
		LOG_ERR("Unable to wait for updated settings");
		return false;
	} else {
		LOG_INF("All settings updates have been received");
		return true;
	}
}

static void validate_settings(void)
{
	if (app_settings_are_valid()) {
		k_sem_give(&settings_valid_sem);
	}
}

int32_t get_stream_delay_s(void)
{
	return s_stream_delay_s;
}

float get_float_length_in(void)
{
	return s_float_length_in;
}

float get_float_offset_in(void)
{
	return s_float_offset_in;
}

int32_t get_accel_num_samples(void)
{
	return s_accel_num_samples;
}

int32_t get_accel_sample_delay_ms(void)
{
	return s_accel_sample_delay_ms;
}

static enum golioth_settings_status on_stream_delay_s_setting(int32_t new_value, void *arg)
{
	/* Only update if value has changed */
	if (s_stream_delay_s == new_value) {
		LOG_DBG("Received STREAM_DELAY_S setting already matches local value.");
	} else {
		s_stream_delay_s = new_value;
		LOG_INF("Set STREAM_DELAY_S setting to %i seconds", s_stream_delay_s);

		wake_system_thread();
	}
	s_stream_delay_s_valid = true;
	validate_settings();
	return GOLIOTH_SETTINGS_SUCCESS;
}

static enum golioth_settings_status on_float_length_in_setting(float new_value, void *arg)
{
	/* Only update if value has changed */
	if (s_float_length_in == new_value) {
		LOG_DBG("Received FLOAT_LENGTH setting already matches local value.");
	} else {
		s_float_length_in = new_value;
		LOG_INF("Set FLOAT_LENGTH setting to %.6f inches", (double)s_float_length_in);
	}
	s_float_length_valid = true;
	validate_settings();
	return GOLIOTH_SETTINGS_SUCCESS;
}

static enum golioth_settings_status on_float_offset_in_setting(float new_value, void *arg)
{
	/* Only update if value has changed */
	if (s_float_offset_in == new_value) {
		LOG_DBG("Received FLOAT_OFFSET setting already matches local value.");
	} else {
		s_float_offset_in = new_value;
		LOG_INF("Set FLOAT_OFFSET setting to %.6f inches", (double)s_float_offset_in);
	}
	s_float_offset_valid = true;
	validate_settings();
	return GOLIOTH_SETTINGS_SUCCESS;
}

static enum golioth_settings_status on_accel_num_samples_setting(int32_t new_value, void *arg)
{
	/* Only update if value has changed */
	if (s_accel_num_samples == new_value) {
		LOG_DBG("Received ACCEL_NUM_SAMPLES setting already matches local value.");
	} else {
		s_accel_num_samples = new_value;
		LOG_INF("Set ACCEL_NUM_SAMPLES setting to %i samples", s_accel_num_samples);
	}
	s_accel_num_samples_valid = true;
	validate_settings();
	return GOLIOTH_SETTINGS_SUCCESS;
}

static enum golioth_settings_status on_accel_sample_delay_ms_setting(int32_t new_value, void *arg)
{
	/* Only update if value has changed */
	if (s_accel_sample_delay_ms == new_value) {
		LOG_DBG("Received ACCEL_SAMPLE_DELAY_MS setting already matches local value.");
	} else {
		s_accel_sample_delay_ms = new_value;
		LOG_INF("Set ACCEL_SAMPLE_DELAY_MS setting to %i milliseconds",
			s_accel_sample_delay_ms);
	}
	s_accel_sample_delay_ms_valid = true;
	validate_settings();
	return GOLIOTH_SETTINGS_SUCCESS;
}

static void check_register_settings_error_and_log(int err, const char *settings_str)
{
	if (err == 0)
	{
		return;
	}

	LOG_ERR("Failed to register settings callback for %s: %d", settings_str, err);
}

void app_settings_init(struct golioth_client *client)
{
	int err;

	if (s_settings) {
		golioth_settings_deinit(s_settings);
	}

	app_settings_invalidate();

	s_settings = golioth_settings_init(client);

	err = golioth_settings_register_int_with_range(s_settings, "STREAM_DELAY_S",
						       STREAM_DELAY_S_MIN, STREAM_DELAY_S_MAX,
						       on_stream_delay_s_setting, NULL);
	check_register_settings_error_and_log(err, "STREAM_DELAY_S");

	err = golioth_settings_register_float(s_settings, "FLOAT_LENGTH",
					      on_float_length_in_setting, NULL);
	check_register_settings_error_and_log(err, "FLOAT_LENGTH");

	err = golioth_settings_register_float(s_settings, "FLOAT_OFFSET",
					      on_float_offset_in_setting, NULL);
	check_register_settings_error_and_log(err, "FLOAT_OFFSET");

	err = golioth_settings_register_int_with_range(s_settings, "ACCEL_NUM_SAMPLES",
						       ACCEL_NUM_SAMPLES_MIN, ACCEL_NUM_SAMPLES_MAX,
						       on_accel_num_samples_setting, NULL);
	check_register_settings_error_and_log(err, "ACCEL_NUM_SAMPLES");

	err = golioth_settings_register_int_with_range(
		s_settings, "ACCEL_SAMPLE_DELAY_MS", ACCEL_SAMPLE_DELAY_MS_MIN,
		ACCEL_SAMPLE_DELAY_MS_MAX, on_accel_sample_delay_ms_setting, NULL);
	check_register_settings_error_and_log(err, "ACCEL_SAMPLE_DELAY_MS");
}
```

## src/app_settings.h
```c
/*
 * Copyright (c) 2022-2023 Golioth, Inc.
 * Copyright (c) 2025 Common Ground Electronics <https://cgnd.dev>
 *
 * SPDX-License-Identifier: Apache-2.0
 */

#ifndef __APP_SETTINGS_H__
#define __APP_SETTINGS_H__

#include <stdint.h>
#include <limits.h>

#include <golioth/client.h>

void app_settings_init(struct golioth_client *client);
bool app_settings_are_valid(void);
void app_settings_invalidate(void);
bool app_settings_wait_for_updates(void);
int32_t get_stream_delay_s(void);
float get_float_length_in(void);
float get_float_offset_in(void);
int32_t get_accel_num_samples(void);
int32_t get_accel_sample_delay_ms(void);

#endif /* __APP_SETTINGS_H__ */
```

## src/math_constants.h
```c
/*
 * Copyright (c) 2025 Common Ground Electronics <https://cgnd.dev>
 *
 * SPDX-License-Identifier: Apache-2.0
 */

/*
 * By default, picolibc is built for Zephyr with the _ZEPHYR_SOURCE feature test
 * macro unless some other API indicator (like _XOPEN_SOURCE) is set. As a
 * result, this does not include some useful math constants like M_PI.
 *
 * See picolibc/newlib/libc/include/sys/features.h and
 * https://github.com/zephyrproject-rtos/zephyr/issues/66909 for more details.
 */

#ifndef MATH_CONSTANTS_H
#define MATH_CONSTANTS_H

#ifndef M_PI
#define M_PI 3.14159265358979323846
#endif

#endif /* MATH_CONSTANTS_H */
```
